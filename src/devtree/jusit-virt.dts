// ==========================================================================
//  JusITOS 0.0.1 — reference-only QEMU 'virt' device-tree fragment
// ===========================================================================
//  This is not a complete DTB or a dtc plugin overlay. Do not compile and pass
//  it as `-machine virt,dtb=...`: doing so replaces QEMU's generated tree and
//  omits required CPU, RAM, interrupt-controller, timer, and device nodes.
//  QEMU virt RAM at 0x40000000 is not a framebuffer. The jkernel display path
//  uses QEMU ramfb configured through fw_cfg; this file is not used by the
//  runner and contains only reference data.
// ==========================================================================

/dts-v1/;
/ {
    model = "JusITOS v0.0.1 console reference board";
    compatible = "jusitos,virt-0.0.1", "qemu,virt";
    #address-cells = <2>;
    #size-cells = <2>;

    aliases {
        serial0 = &uart0;
    };

    /* Existing QEMU virt base nodes are inherited when you DON'T pass
       a -dtb flag. If you do pass a dtb, you must include ALL the base
       nodes — copy them from qemu's hw/arm/virt.c defaults. */

    uart0: serial@9000000 {
        compatible = "arm,pl011", "arm,primecell";
        reg = <0x0 0x09000000 0x0 0x1000>;
        clock-frequency = <0x16e3600>;
    };
};
